## sdkconfig.defaults
```kconfig
# LVGL Font Configuration
CONFIG_LV_FONT_MONTSERRAT_14=y
CONFIG_LV_FONT_MONTSERRAT_20=y
CONFIG_LV_FONT_MONTSERRAT_24=y
CONFIG_LV_FONT_MONTSERRAT_28=y
CONFIG_LV_FONT_MONTSERRAT_32=y
CONFIG_LV_FONT_MONTSERRAT_36=y
CONFIG_LV_FONT_MONTSERRAT_48=y
CONFIG_LV_FONT_MONTSERRAT_16=y
CONFIG_LV_FONT_MONTSERRAT_18=y
CONFIG_LV_FONT_MONTSERRAT_40=y
CONFIG_LV_FONT_MONTSERRAT_22=y

CONFIG_ESP_HOSTED_SDIO_HOST_INTERFACE=y
CONFIG_ESP_HOSTED_SDIO_BUS_WIDTH=4
CONFIG_ESP_HOSTED_SDIO_CLOCK_FREQ_KHZ=25000
CONFIG_ESP_HOSTED_SDIO_TX_Q_SIZE=10
CONFIG_ESP_HOSTED_SDIO_RX_Q_SIZE=10
CONFIG_ESP_HOSTED_SDIO_PIN_CMD=47
CONFIG_ESP_HOSTED_SDIO_PIN_CLK=48
CONFIG_ESP_HOSTED_SDIO_PIN_D0=49
CONFIG_ESP_HOSTED_SDIO_PRIV_PIN_D1_4BIT_BUS=50
CONFIG_ESP_HOSTED_SDIO_PIN_D1=50
CONFIG_ESP_HOSTED_SDIO_PIN_D2=51
CONFIG_ESP_HOSTED_SDIO_PIN_D3=52
CONFIG_ESP_HOSTED_SDIO_GPIO_RESET_SLAVE=54
CONFIG_ESP_HOSTED_SD_PWR_CTRL_LDO_INTERNAL_IO=y
CONFIG_ESP_HOSTED_SDIO_HOST_INTERFACE=y


# Flash Size - 16MB
CONFIG_ESPTOOLPY_FLASHSIZE_16MB=y
CONFIG_ESPTOOLPY_FLASHSIZE="16MB"

# SPIRAM / PSRAM
# NOTE: SPIRAM_SPEED_200M requires IDF_EXPERIMENTAL_FEATURES (ESP32-P4 Kconfig dependency)
CONFIG_IDF_EXPERIMENTAL_FEATURES=y
CONFIG_SPIRAM=y
CONFIG_SPIRAM_MODE_HEX=y
CONFIG_SPIRAM_SPEED_80M=y
CONFIG_SPIRAM_SPEED=80
CONFIG_SPIRAM_BOOT_HW_INIT=y
CONFIG_SPIRAM_BOOT_INIT=y
CONFIG_SPIRAM_PRE_CONFIGURE_MEMORY_PROTECTION=y

CONFIG_SPIRAM_USE_MALLOC=y
CONFIG_SPIRAM_MEMTEST=y
CONFIG_SPIRAM_MALLOC_ALWAYSINTERNAL=131072
CONFIG_SPIRAM_MALLOC_RESERVE_INTERNAL=32768
#CONFIG_SPIRAM_ALLOW_STACK_EXTERNAL_MEMORY is not set

# Partition Table
CONFIG_PARTITION_TABLE_CUSTOM=y
CONFIG_PARTITION_TABLE_CUSTOM_FILENAME="partitions-16MiB.csv"
CONFIG_PARTITION_TABLE_FILENAME="partitions-16MiB.csv"

# ESP-Hosted SDIO queue sizes
CONFIG_ESP_HOSTED_SDIO_TX_Q_SIZE=10
CONFIG_ESP_HOSTED_SDIO_RX_Q_SIZE=10
# CONFIG_ESP_HOSTED_DFLT_TASK_FROM_SPIRAM is not set

CONFIG_SR_WN_WN9_HILEXIN=y
CONFIG_SR_MN_CN_MULTINET7_QUANT=y
CONFIG_SR_MN_EN_NONE=y

CONFIG_USB_HOST_DWC_DMA_CAP_MEMORY_IN_PSRAM=y

# ESP32-P4 Chip Revision: v1.x (< v3.0), must use esp32p4_less_v3 ESP-SR libraries
# (the standard esp32p4 lib uses SIMD memcpy that crashes on v1.x chip with PSRAM)
CONFIG_ESP32P4_SELECTS_REV_LESS_V3=y

# ESP32-P4 Cache Configuration (ESP-SR requires L2 Cache >= 256KB, line >= 128B)
CONFIG_CACHE_L2_CACHE_256KB=y
CONFIG_CACHE_L2_CACHE_LINE_128B=y

# Main Task Stack - enlarged to prevent stack overflow during SR model loading
CONFIG_ESP_MAIN_TASK_STACK_SIZE=16384

# Enable frame pointer for better crash backtrace
CONFIG_ESP_SYSTEM_USE_FRAME_POINTER=y
```
